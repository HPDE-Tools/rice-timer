## main/Kconfig.projbuild
```kconfig
menu "ShiftWatch on ESP32"
    menu "File System"
        config MOUNT_ROOT
            string "Root path of the sdcard in VFS"
            default "/s"
    endmenu
    menu "Logging"
        config MAX_LINES_PER_FILE
            int "Max lines written to a log file"
            default 10000
    endmenu
    menu "CAN"
        config CAN_BAUD_RATE
            int "baud rate of CAN bus input (unused for now)"
            default 500000
    endmenu
    menu "Pinout"
        config HW_VERSION
            int "build for which hardware version"
            default 1
    endmenu
endmenu
```

## sdkconfig.defaults
```kconfig
### ShiftWatch

CONFIG_MOUNT_ROOT="/s"
CONFIG_MAX_LINES_PER_FILE=100000
CONFIG_CAN_BAUD_RATE=500000
CONFIG_HW_VERSION=3


#####################################################


### CPU

# CONFIG_ESP32_DEFAULT_CPU_FREQ_80 is not set
# CONFIG_ESP32_DEFAULT_CPU_FREQ_160 is not set
CONFIG_ESP32_DEFAULT_CPU_FREQ_240=y
CONFIG_ESP32_DEFAULT_CPU_FREQ_MHZ=240


### Panic

CONFIG_ESP_SYSTEM_PANIC_PRINT_HALT=y
# CONFIG_ESP_SYSTEM_PANIC_PRINT_REBOOT is not set
# CONFIG_ESP_SYSTEM_PANIC_SILENT_REBOOT is not set
# CONFIG_ESP_SYSTEM_PANIC_GDBSTUB is not set


### Compiler

# CONFIG_ESP32_REV_MIN_0 is not set
# CONFIG_ESP32_REV_MIN_1 is not set
CONFIG_ESP32_REV_MIN_2=y
# CONFIG_ESP32_REV_MIN_3 is not set
CONFIG_ESP32_REV_MIN=2

CONFIG_COMPILER_OPTIMIZATION_PERF=y
CONFIG_COMPILER_CXX_EXCEPTIONS=y
CONFIG_COMPILER_CXX_EXCEPTIONS_EMG_POOL_SIZE=512
CONFIG_COMPILER_STACK_CHECK_MODE_NORM=y
CONFIG_COMPILER_STACK_CHECK=y


### Flash

CONFIG_ESPTOOLPY_FLASHMODE_QIO=y
CONFIG_ESPTOOLPY_FLASHFREQ_80M=y
CONFIG_ESPTOOLPY_FLASHFREQ="80m"


### Monitor

CONFIG_ESP_CONSOLE_UART_CUSTOM=y
CONFIG_ESP_CONSOLE_UART=y
CONFIG_ESP_CONSOLE_MULTIPLE_UART=y
CONFIG_ESP_CONSOLE_UART_CUSTOM_NUM_0=y
# CONFIG_ESP_CONSOLE_UART_CUSTOM_NUM_1 is not set
CONFIG_ESP_CONSOLE_UART_NUM=0
CONFIG_ESP_CONSOLE_UART_TX_GPIO=1
CONFIG_ESP_CONSOLE_UART_RX_GPIO=3
CONFIG_ESP_CONSOLE_UART_BAUDRATE=500000
CONFIG_ESPTOOLPY_MONITOR_BAUD_CONSOLE=y
CONFIG_ESPTOOLPY_MONITOR_BAUD=500000




### Peripherals

CONFIG_SPI_MASTER_IN_IRAM=y
CONFIG_SPI_MASTER_ISR_IN_IRAM=y

CONFIG_TWAI_ISR_IN_IRAM=y

CONFIG_UART_ISR_IN_IRAM=y



#####################################################


### FATFS

# CONFIG_FATFS_LFN_NONE is not set
CONFIG_FATFS_LFN_HEAP=y
# CONFIG_FATFS_LFN_STACK is not set
CONFIG_FATFS_MAX_LFN=255
CONFIG_FATFS_API_ENCODING_ANSI_OEM=y
# CONFIG_FATFS_API_ENCODING_UTF_16 is not set
# CONFIG_FATFS_API_ENCODING_UTF_8 is not set


### FREERTOS

CONFIG_FREERTOS_HZ=1000


### LVGL

CONFIG_LV_DISP_DEF_REFR_PERIOD=50
CONFIG_LV_INDEV_DEF_READ_PERIOD=50

CONFIG_LV_ATTRIBUTE_FAST_MEM_USE_IRAM=y
CONFIG_LV_CONF_MINIMAL=y
CONFIG_LV_CONF_SKIP=y

CONFIG_LV_COLOR_DEPTH_1=y
CONFIG_LV_COLOR_DEPTH=1
CONFIG_LV_COLOR_CHROMA_KEY_HEX=0x00FF00

CONFIG_LV_MEM_CUSTOM=y
CONFIG_LV_MEM_CUSTOM_INCLUDE="stdlib.h"
CONFIG_LV_MEMCPY_MEMSET_STD=y

CONFIG_LV_DISP_DEF_REFR_PERIOD=50
CONFIG_LV_INDEV_DEF_READ_PERIOD=50
CONFIG_LV_TICK_CUSTOM=y
CONFIG_LV_TICK_CUSTOM_INCLUDE="lvgl_tick.h"
CONFIG_LV_DPI_DEF=100

CONFIG_LV_DRAW_COMPLEX=y
CONFIG_LV_SHADOW_CACHE_SIZE=0
CONFIG_LV_IMG_CACHE_DEF_SIZE=0

CONFIG_LV_USE_USER_DATA=y

CONFIG_LV_USE_THEME_BASIC=y

CONFIG_LV_USE_ARC=y
CONFIG_LV_USE_BAR=y
CONFIG_LV_USE_BTN=y
CONFIG_LV_USE_BTNMATRIX=y
CONFIG_LV_USE_CANVAS=y
CONFIG_LV_USE_CHECKBOX=y
CONFIG_LV_USE_CHART=y
CONFIG_LV_USE_DROPDOWN=y
CONFIG_LV_USE_IMG=y
CONFIG_LV_USE_LABEL=y
CONFIG_LV_USE_LINE=y
CONFIG_LV_USE_METER=y
CONFIG_LV_USE_ROLLER=y
CONFIG_LV_USE_SLIDER=y
CONFIG_LV_USE_SWITCH=y
CONFIG_LV_USE_TEXTAREA=y
CONFIG_LV_USE_TABLE=y

CONFIG_LV_USE_LIST=y
CONFIG_LV_USE_MSGBOX=y
CONFIG_LV_USE_SPINBOX=y
CONFIG_LV_USE_TABVIEW=y
CONFIG_LV_USE_TILEVIEW=y

CONFIG_LV_USE_FLEX=y
CONFIG_LV_USE_GRID=y
```
